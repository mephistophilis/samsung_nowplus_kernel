## samsung/Kconfig
```kconfig
##
# Copyright (C) 2010, Samsung Electronics Co., Ltd. All Rights Reserved.
#  Written by System S/W Group, Open OS S/W R&D Team,
#  Mobile Communication Division.
##

##
# Project Name : Samsung Private Third-Party Device Drivers
#
# Project Description :
#
# Comments : tabstop = 8, shiftwidth = 8, noexpandtab
##

##
# File Name : Kconfig
#
# File Description :
#
# Author : Joo, Young Jin (#4349, youngjin79.joo@samsung.com)
# Dept : System S/W Group (Open OS S/W R&D Team)
# Created Date : 09-Jul-2010
# Version : Baby-Raccoon
##

menu "Samsung Private Third-Party Device Drivers"

menu "Immersion Touch Sense Driver (vibetonz)"
source "samsung/vibetonz/Kconfig"
endmenu

menu "Samsung Battery Driver"
source "samsung/battery/Kconfig"
endmenu

menu "Samsung Proximity/Light Sensor Driver"
source "samsung/PL_sensor/Kconfig"
endmenu

menu "Kionix KXSD9 Accelerometer Driver"
source "samsung/kxsd9/Kconfig"
endmenu

menu "Samsung Dpram Driver"
source "samsung/dpram/Kconfig"
endmenu

menu "Samsung Multiple Packet Data Protocol Support"
source "samsung/multipdp/Kconfig"
endmenu

menu "Si4709 FM radio"
source "samsung/fm_si4709/Kconfig"
endmenu

endmenu
```
